## Kconfig.projbuild
```kconfig
menu "Nix-Board-ESP32"
    choice NIX_BOARD_ESP32_BOARD
        prompt "Select Nix-Board-ESP32 board"
        default NIX_BOARD_ESP32_BOARD_CUSTOM
        config NIX_BOARD_ESP32_BOARD_CUSTOM
            bool "Custom board"
        config NIX_BOARD_ESP32_BOARD_M5STACK_CORE_S3
            bool "M5Stack Core S3"
            depends on IDF_TARGET_ESP32S3
        config NIX_BOARD_ESP32_BOARD_M5STACK_CARDPUTER
            bool "M5Stack Cardputer"
            depends on IDF_TARGET_ESP32S3
        config NIX_BOARD_ESP32_BOARD_M5STACK_TAB5
            bool "M5Stack Tab5"
            depends on IDF_TARGET_ESP32P4
        config NIX_BOARD_ESP32_BOARD_LILYGO_T_LORA_PAGER
            bool "LilyGo T-LoraPager"
            depends on IDF_TARGET_ESP32S3
    endchoice

    config NIX_BOARD_ESP32_BOARD_M5STACK_POWERHUB
        bool "M5Stack PowerHub"
        default n
        help
            M5Stack PowerHub 板级支持。当前实现尚不完善，默认不编译。
endmenu
```
